## kernel/drivers/i2c/chips/Kconfig
```kconfig
#
# Miscellaneous I2C chip drivers configuration
#
# *** DEPRECATED! Do not add new entries! See Makefile ***
#

menu "Miscellaneous I2C Chip support"

config SOUND_FM2018
	tristate "FM2018 Echo Clear Driver"
	depends on I2C
	default n
	help
	  FM2018 Echo Clear Driver implemented by COOLPAD.

endmenu
```

## kernel/drivers/sensors/Kconfig
```kconfig
#
# sensors devices
#

menu "Sensors Drivers"

source "drivers/sensors/mma8452/Kconfig"
source "drivers/sensors/al3006/Kconfig"
source "drivers/sensors/tmd2771/Kconfig"
source "drivers/sensors/ltr558/Kconfig"
source "drivers/sensors/bmc050/Kconfig"
source "drivers/sensors/akm8975/Kconfig"
source "drivers/sensors/lis3dh/Kconfig"
source "drivers/sensors/lsm303d/Kconfig"

endmenu
```

## kernel/drivers/sensors/akm8975/Kconfig
```kconfig
config SENSORS_AKM8975
	tristate "akm8975 Compass Support"
	depends on I2C=y
	help
	  akm8975 Compass Driver
```

## kernel/drivers/sensors/al3006/Kconfig
```kconfig
config SENSORS_AL3006
	tristate "al3006 ALS&Proximity Support"
	depends on I2C=y
	help
	  al3006 ALS&Proximity Driver
	  
```

## kernel/drivers/sensors/lis3dh/Kconfig
```kconfig
config SENSORS_LIS3DH
	tristate "lis3dh Acceleration Support"
	depends on I2C=y
	help
	  lis3dh Acceleration Driver
```

## kernel/drivers/sensors/lsm303d/Kconfig
```kconfig
config SENSORS_LSM303D
	tristate "lsm303d Acceleration&&compass Support"
	depends on I2C=y
	help
	  lsm303d Acceleration&&compass Driver
```

## kernel/drivers/sensors/ltr558/Kconfig
```kconfig
config SENSORS_LTR558
	tristate "ltr558 ALS&Proximity Support"
	depends on I2C
	help
	  ltr558 ALS&Proximity Driver
	  
```

## kernel/drivers/sensors/mma8452/Kconfig
```kconfig
config SENSORS_MMA8452
	tristate "mma8452 Acceleration Support"
	depends on I2C=y
	help
	  mma8452 Acceleration Driver
```

## kernel/drivers/sensors/tmd2771/Kconfig
```kconfig
config SENSORS_TMD2771
	tristate "tmd2771 ALS&Proximity Support"
	depends on I2C=y
	help
	  tmd2771 ALS&Proximity Driver
	  
```

## kernel/drivers/yl_debug/Kconfig
```kconfig
#
# mis
#

config ANDROID_DEV_DEBUG
	bool "android device debug support"
	help
	  for debug value & gpio change

config YULONG_DEBUG
	bool "debug support"
	help
	  for debug value & gpio change

config YULONG_MODULE_MANAGEMENT
	bool "yulong module management support"
	help
	  The driver provides an method for on or off device.
```
